## main/Kconfig
```kconfig
menu "Envi Sensor"
    config READ_SENSOR_FREQUENCY_MS
        int "Configure reading frequency for temperature and humidity sensor"
        default 30000
        help
            The temperature and humidity sensor can be read more or less often.
            Together with CONFIG_LCD_RINGBUF_DATA_LEN, this value will impact
            how long historical data will be stored.

    config LCD_RINGBUF_DATA_LEN
        int "Configure number of readings stored in each ring-buffer"
        default 240
        help
            The number of readings held in each of ringbuf_lcd_temperature and ringbuf_lcd_humidity.
            Together with CONFIG_READ_SENSOR_FREQUENCY_MS, this value will impact
            how long historical data will be stored.
endmenu
```
